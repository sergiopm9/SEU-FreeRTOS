## esp32-scheduler1/sdkconfig.defaults
```kconfig
# Run on single core (PRO_CPU only)
CONFIG_FREERTOS_UNICORE=y

# Prioritized Pre-emptive Scheduling with Time Slicing (default)
# CONFIG_FREERTOS_USE_PREEMPTION defaults to y
# CONFIG_FREERTOS_USE_TIME_SLICING defaults to y
```
